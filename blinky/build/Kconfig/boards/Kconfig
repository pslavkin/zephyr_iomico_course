## blinky/build/Kconfig/boards/Kconfig
```kconfig
# Load Zephyr board Kconfig descriptions.
osource "/home/pslavkin/z/zephyrproject/zephyr/boards/nordic/nrf9161dk/Kconfig"
```

## blinky/build/Kconfig/boards/Kconfig.defconfig
```kconfig
# Load Zephyr board defconfig descriptions.
osource "/home/pslavkin/z/zephyrproject/zephyr/boards/nordic/nrf9161dk/Kconfig.defconfig"
```

## blinky/build/Kconfig/boards/Kconfig.nrf9161dk
```kconfig
# Load board Kconfig descriptions.
osource "/home/pslavkin/z/zephyrproject/zephyr/boards/nordic/nrf9161dk/Kconfig.nrf9161dk"
```

## build/Kconfig/Kconfig.modules
```kconfig
menu "cmsis (/home/pslavkin/z/zephyrproject/modules/hal/cmsis)"
osource "$(ZEPHYR_CMSIS_KCONFIG)"
config ZEPHYR_CMSIS_MODULE
	bool
	default y
endmenu
menu "cmsis-dsp (/home/pslavkin/z/zephyrproject/modules/lib/cmsis-dsp)"
osource "$(ZEPHYR_CMSIS_DSP_KCONFIG)"
config ZEPHYR_CMSIS_DSP_MODULE
	bool
	default y
endmenu
menu "hal_nordic (/home/pslavkin/z/zephyrproject/modules/hal/nordic)"
osource "$(ZEPHYR_HAL_NORDIC_KCONFIG)"
config ZEPHYR_HAL_NORDIC_MODULE
	bool
	default y

config ZEPHYR_HAL_NORDIC_MODULE_BLOBS
	bool
endmenu
config ZEPHYR_TI_MODULE
	bool
	default y
```

## build/Kconfig/Kconfig.sysbuild.modules
```kconfig
config ZEPHYR_CMSIS_MODULE
   bool
   default y
config ZEPHYR_CMSIS_DSP_MODULE
   bool
   default y
config ZEPHYR_HAL_NORDIC_MODULE
   bool
   default y
config ZEPHYR_TI_MODULE
   bool
   default y
```

## build/Kconfig/arch/Kconfig
```kconfig
# Load Zephyr Arch Kconfig descriptions.
osource "/home/pslavkin/z/zephyrproject/zephyr/arch/x86/Kconfig"
osource "/home/pslavkin/z/zephyrproject/zephyr/arch/xtensa/Kconfig"
osource "/home/pslavkin/z/zephyrproject/zephyr/arch/sparc/Kconfig"
osource "/home/pslavkin/z/zephyrproject/zephyr/arch/riscv/Kconfig"
osource "/home/pslavkin/z/zephyrproject/zephyr/arch/posix/Kconfig"
osource "/home/pslavkin/z/zephyrproject/zephyr/arch/nios2/Kconfig"
osource "/home/pslavkin/z/zephyrproject/zephyr/arch/mips/Kconfig"
osource "/home/pslavkin/z/zephyrproject/zephyr/arch/arm64/Kconfig"
osource "/home/pslavkin/z/zephyrproject/zephyr/arch/arm/Kconfig"
osource "/home/pslavkin/z/zephyrproject/zephyr/arch/arc/Kconfig"
```

## services/Kconfig.services
```kconfig
#menu "services options"

config IOMICO_SERVICES
    bool "service options"
    default n

if  IOMICO_SERVICES

config IOMICO_SERVICES_A
    int "option services number A" 
    default 123
    depends on IOMICO_OPTION_A

config IOMICO_SERVICES_B
    hex "option services number B" 
    default bbb

config IOMICO_SERVICES_C
    hex "option services number C" 
    default 1 if IOMICO_OPTION_A && IOMICO_OPTION_B > 10
    default ccc

config IOMICO_SERVICES_D
    bool "option services number D" 
    select IOMICO_OPTION_A #forces the selection of IOMICO_OPTION_A

endif 

#endmenu
```
